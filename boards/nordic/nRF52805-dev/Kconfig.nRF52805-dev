## boards/nordic/nRF52805-dev/Kconfig.nRF52805-dev
```kconfig
config BOARD_NRF52805-DEV
	bool "nRF52805 Dev Kit"
	depends on SOC_NRF52805_QFAA
```

## boards/nordic/nRF52810-dev/Kconfig.nRF52810-dev
```kconfig
config BOARD_NRF52810-DEV
	bool "nRF52810 Dev Kit"
	depends on SOC_NRF52810_QFAA
```

## boards/nordic/nrf52_dev/Kconfig.defconfig
```kconfig
# nRF52 DEV board configuration

# Copyright (c) 2025 Nordic Semiconductor ASA
# SPDX-License-Identifier: Apache-2.0

if BOARD_NRF52_DEV

config HW_STACK_PROTECTION
	default ARCH_HAS_STACK_PROTECTION

endif # BOARD_NRF52_DEV
```

## boards/nordic/nrf52_dev/Kconfig.nrf52_dev
```kconfig
# nRF52 DEV nRF52810 board configuration

# Copyright (c) 2018 Nordic Semiconductor ASA
# SPDX-License-Identifier: Apache-2.0

config BOARD_NRF52_DEV
	select SOC_NRF52805_CAAA if BOARD_NRF52_DEV_NRF52805
	select SOC_NRF52810_QFAA if BOARD_NRF52_DEV_NRF52810
	select SOC_NRF52832_QFAA if BOARD_NRF52_DEV_NRF52832
```

## boards/nordic/nrf52_dev/board.yml
```yaml
board:
  name: nrf52_dev
  full_name: nRF52 DEV
  vendor: nordic
  socs:
  - name: nrf52805
  - name: nrf52810
  - name: nrf52832
```
